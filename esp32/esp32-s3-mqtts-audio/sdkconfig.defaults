## esp32/esp32-s3-mqtts-audio/sdkconfig.defaults
```kconfig
# ESP32-S3 MQTTS音频通信 - 默认配置
# V4.0云端架构版

# ==================== 芯片目标 ====================
CONFIG_IDF_TARGET="esp32s3"

# ==================== PSRAM配置 ====================
# 启用PSRAM (8MB)
CONFIG_SPIRAM=y
CONFIG_SPIRAM_MODE_OCT=y
CONFIG_SPIRAM_SPEED_80M=y

# PSRAM内存分配策略
CONFIG_SPIRAM_MALLOC_ALWAYSINTERNAL=0
CONFIG_SPIRAM_TRY_ALLOCATE_WIFI_LWIP=y
CONFIG_SPIRAM_ALLOW_BSS_SEG_EXTERNAL_MEMORY=y

# ==================== mbedTLS内存优化 (CRITICAL!) ====================
# 防止TLS握手时OOM - 必须配置
CONFIG_MBEDTLS_SSL_IN_CONTENT_LEN=16384
CONFIG_MBEDTLS_SSL_OUT_CONTENT_LEN=4096

# 启用动态内存分配
CONFIG_MBEDTLS_DYNAMIC_BUFFER=y
CONFIG_MBEDTLS_DYNAMIC_FREE_PEER_CERT=y
CONFIG_MBEDTLS_DYNAMIC_FREE_CONFIG_DATA=y

# 使用PSRAM存储mbedTLS缓冲区
CONFIG_MBEDTLS_SSL_CONTEXT_SERIALIZATION=n
CONFIG_MBEDTLS_CERTIFICATE_BUNDLE=y

# ==================== WiFi配置 ====================
CONFIG_ESP_WIFI_STATIC_RX_BUFFER_NUM=10
CONFIG_ESP_WIFI_DYNAMIC_RX_BUFFER_NUM=32
CONFIG_ESP_WIFI_DYNAMIC_TX_BUFFER_NUM=32
CONFIG_ESP_WIFI_AMPDU_TX_ENABLED=y
CONFIG_ESP_WIFI_AMPDU_RX_ENABLED=y

# ==================== MQTT配置 ====================
CONFIG_MQTT_PROTOCOL_5=y
CONFIG_MQTT_TRANSPORT_SSL=y
CONFIG_MQTT_TRANSPORT_WEBSOCKET=y
CONFIG_MQTT_TRANSPORT_WEBSOCKET_SECURE=y

# ==================== FreeRTOS配置 ====================
CONFIG_FREERTOS_HZ=1000
CONFIG_FREERTOS_TIMER_TASK_STACK_DEPTH=4096
CONFIG_FREERTOS_USE_TRACE_FACILITY=y
CONFIG_FREERTOS_GENERATE_RUN_TIME_STATS=y

# ==================== CPU和系统配置 ====================
CONFIG_ESP_DEFAULT_CPU_FREQ_MHZ_240=y
CONFIG_ESP_SYSTEM_EVENT_TASK_STACK_SIZE=4096

# ==================== LOG配置 ====================
CONFIG_LOG_DEFAULT_LEVEL_INFO=y
CONFIG_LOG_MAXIMUM_LEVEL_VERBOSE=y

# ==================== Flash配置 ====================
CONFIG_ESPTOOLPY_FLASHSIZE_16MB=y
CONFIG_PARTITION_TABLE_CUSTOM=n

# ==================== I2S配置 ====================
# 默认启用I2S驱动
CONFIG_I2S_ENABLE_DEBUG_LOG=n
```
